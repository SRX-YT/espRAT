/*
 ***********
 * INCLUDE *
 ***********
*/

#include <Wire.h>
#include <Adafruit_GFX.h>
#include <Adafruit_SSD1306.h>
#include <ezButton.h>

/*
 **********
 * DEFINE *
 **********
*/

#define SCREEN_WIDTH 128
#define SCREEN_HEIGHT 64
#define LOGO_HEIGHT 128
#define LOGO_WIDTH 64
#define DEBOUNCE_TIME 20

/*
 *****************
 * SPLASH_SCREEN *
 *****************
*/

const unsigned char PROGMEM logo_bmp[] = {
  0x00, 0x00, 0x00, 0x00, 0x00, 0x00, 0x00, 0x00, 0x00, 0x00, 0x00, 0x00, 0x00, 0x00, 0x00, 0x00,
  0x00, 0x00, 0x00, 0x00, 0x00, 0x00, 0x00, 0x00, 0x00, 0x00, 0x00, 0x00, 0x00, 0x00, 0x00, 0x00,
  0x00, 0x00, 0x00, 0x00, 0x00, 0x00, 0x00, 0x00, 0x00, 0x00, 0x00, 0x00, 0x00, 0x00, 0x00, 0x00,
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  0x00, 0x00, 0x00, 0x00, 0x00, 0x00, 0x00, 0x00, 0x00, 0x00, 0x00, 0x00, 0x00, 0x00, 0x00, 0x00
};

/*
 *******
 * HUD *
 *******
*/

const unsigned char PROGMEM logo_wifi[]{
  0x00, 0x00, 0x1f, 0x00, 0x20, 0x80, 0x4e, 0x40, 0x11, 0x00, 0x20, 0x80, 0x0e, 0x00, 0x11, 0x00,
  0x04, 0x00, 0x0e, 0x00, 0x04, 0x00
};
const unsigned char PROGMEM logo_nowifi[]{
  0x80, 0x20, 0x5f, 0x40, 0x20, 0x80, 0x5f, 0x40, 0x1b, 0x00, 0x24, 0x80, 0x0e, 0x00, 0x11, 0x00,
  0x24, 0x80, 0x4e, 0x40, 0x84, 0x20
};
const unsigned char PROGMEM logo_bt[]{
  0x02, 0x00, 0x05, 0x00, 0x04, 0x80, 0x14, 0x80, 0x0d, 0x00, 0x0e, 0x00, 0x0d, 0x00, 0x14, 0x80,
  0x04, 0x80, 0x05, 0x00, 0x02, 0x00
};
const unsigned char PROGMEM logo_nobt[]{
  0x82, 0x20, 0x45, 0x40, 0x24, 0x80, 0x15, 0x80, 0x0f, 0x00, 0x0e, 0x00, 0x0f, 0x00, 0x15, 0x80,
  0x24, 0x80, 0x45, 0x40, 0x82, 0x20
};

/*
 *********************
 * DEVICE PARAMETERS *
 *********************
*/

bool b_isConnectedToWifi = true;
bool b_isConnectedToBT = true;
bool b_isCharging = true;
int i_batteryPercent = 100;
char c_currentTime[6] = "12:34";

/*
 ********
 * MENU *
 ********
*/

const char* c_menuItems[] = { "WIFI", "BLUETOOTH", "BADUSB", "GAMES", "SETTINGS", "TURN OFF" };
const int i_menuSize = sizeof(c_menuItems) / sizeof(c_menuItems[0]);
int i_currentSelection = 0;
const unsigned char PROGMEM logo_evilusb[]{
  0x0e, 0x00, 0x31, 0x80, 0x40, 0x40, 0x40, 0x40, 0x9b, 0x20, 0xbb, 0xa0, 0x80, 0x20, 0x84, 0x20,
  0x60, 0xc0, 0x15, 0x00, 0x1f, 0x00
};
const unsigned char PROGMEM logo_settings[]{
  0x44, 0x40, 0x44, 0x40, 0x4a, 0x40, 0x44, 0x40, 0x44, 0x40, 0xa4, 0x40, 0x44, 0x40, 0x44, 0x40,
  0x44, 0xa0, 0x44, 0x40, 0x44, 0x40
};
const unsigned char PROGMEM logo_turnoff[]{
  0x04, 0x00, 0x04, 0x00, 0x35, 0x80, 0x24, 0x80, 0x40, 0x40, 0x40, 0x40, 0x40, 0x40, 0x20, 0x80,
  0x31, 0x80, 0x0e, 0x00, 0x00, 0x00
};
const unsigned char PROGMEM logo_games[]{
  0x00, 0x00, 0x00, 0x00, 0x00, 0x00, 0x20, 0x80, 0x11, 0x00, 0x3f, 0x80, 0x6e, 0xc0, 0xff, 0xe0, 
	0xbf, 0xa0, 0xa0, 0xa0, 0x1b, 0x00
};

/*
 ********
 * WIFI *
 ********
*/

const char* c_wifiItems[] = { "WIFITEST", "WIFITEST", "WIFITEST" };
const int i_wifiSize = sizeof(c_wifiItems) / sizeof(c_wifiItems[0]);

/*
 *************
 * BLUETOOTH *
 *************
*/

const char* c_btItems[] = { "BLUETOOTHTEST", "BLUETOOTHTEST", "BLUETOOTHTEST" };
const int i_btSize = sizeof(c_btItems) / sizeof(c_btItems[0]);

/*
 **********
 * BADUSB *
 **********
*/

const char* c_badusbItems[] = { "BADUSBTEST", "BADUSBTEST", "BADUSBTEST" };
const int i_badusbSize = sizeof(c_badusbItems) / sizeof(c_badusbItems[0]);

/*
 *********
 * GAMES *
 *********
*/

const char* c_gamesItems[] = { "GAMESTEST", "GAMESTEST", "GAMESTEST" };
const int i_gamesSize = sizeof(c_gamesItems) / sizeof(c_gamesItems[0]);

/*
 ************
 * SETTINGS *
 ************
*/

const char* c_settingsItems[] = { "SETTINGSTEST", "SETTINGSTEST", "SETTINGSTEST" };
const int i_settingsSize = sizeof(c_settingsItems) / sizeof(c_settingsItems[0]);

/*
 ***********
 * BUTTONS *
 ***********
*/

ezButton btn_up(32);
ezButton btn_down(33);
ezButton btn_ok(27);
ezButton btn_back(14);

/*
 *********
 * OTHER *
 *********
*/

Adafruit_SSD1306 display(SCREEN_WIDTH, SCREEN_HEIGHT, &Wire, -1);
enum WhereAt {
  MENU,
  WIFI,
  BLUETOOTH,
  BADUSB,
  GAMES,
  SETTINGS
};
enum WhereAt wh;


/*
 *********
 * START *
 *********
*/

void setup() {
  Serial.begin(115200);

  if(!display.begin(SSD1306_SWITCHCAPVCC, 0x3C)) { 
    Serial.println(F("SSD1306 allocation failed"));
    for(;;); // Don't proceed, loop forever
  }

  btn_up.setDebounceTime(DEBOUNCE_TIME);
  btn_down.setDebounceTime(DEBOUNCE_TIME);
  btn_ok.setDebounceTime(DEBOUNCE_TIME);
  btn_back.setDebounceTime(DEBOUNCE_TIME);

  helloDisplay();
  delay(3000);
  menuDisplay();

  wh = MENU;
}

/*
 **********
 * UPDATE *
 **********
*/

void loop() {
  btn_up.loop();
  btn_down.loop();
  btn_ok.loop();
  btn_back.loop();

  if (btn_down.isReleased()) {
    switch(wh) {
      case MENU:
        if (i_currentSelection < i_menuSize - 1) { i_currentSelection += 1; }
        menuDisplay();
        break;
      case WIFI:
        if (i_currentSelection < i_wifiSize - 1) { i_currentSelection += 1; }
        wifiDisplay();
        break;
      case BLUETOOTH:
        if (i_currentSelection < i_btSize - 1) { i_currentSelection += 1; }
        btDisplay();
        break;
      case BADUSB:
        if (i_currentSelection < i_badusbSize - 1) { i_currentSelection += 1; }
        badusbDisplay();
        break;
      case GAMES:
        if (i_currentSelection < i_gamesSize - 1) { i_currentSelection += 1; }
        gamesDisplay();
        break;
      case SETTINGS:
        if (i_currentSelection < i_settingsSize - 1) { i_currentSelection += 1; }
        settingsDisplay();
        break;
      default:
        break;
    }
  }
  if (btn_up.isReleased()) {
    switch(wh) {
      case MENU:
        if (i_currentSelection > 0) { i_currentSelection -= 1; }
        menuDisplay();
        break;
      case WIFI:
        if (i_currentSelection > 0) { i_currentSelection -= 1; }
        wifiDisplay();
        break;
      case BLUETOOTH:
        if (i_currentSelection > 0) { i_currentSelection -= 1; }
        btDisplay();
        break;
      case BADUSB:
        if (i_currentSelection > 0) { i_currentSelection -= 1; }
        badusbDisplay();
        break;
      case GAMES:
        if (i_currentSelection > 0) { i_currentSelection -= 1; }
        gamesDisplay();
        break;
      case SETTINGS:
        if (i_currentSelection > 0) { i_currentSelection -= 1; }
        settingsDisplay();
        break;
      default:
        break;
    }
  }
  if (btn_ok.isReleased()) {
    if (wh == MENU) {
      switch(i_currentSelection) {
        case 0:
          wifiDisplay();
          wh = WIFI;
          break;
        case 1:
          btDisplay();
          wh = BLUETOOTH;
          break;
        case 2:
          badusbDisplay();
          wh = BADUSB;
          break;
        case 3:
          gamesDisplay();
          wh = GAMES;
          break;
        case 4:
          settingsDisplay();
          wh = SETTINGS;
          break;
        case 5:
          shutoff();
          break;
        default:
          // TODO: MAKE A LOG ON SD
          shutoff();
          break;
      }
    }
    i_currentSelection = 0;
  }
  if (btn_back.isReleased()) {
    if (wh != MENU) {
      menuDisplay();
      wh = MENU;
    }
    i_currentSelection = 0;
  }
}

/*
 *****************
 * SPLASH_SCREEN *
 *****************
*/

void helloDisplay() {
  display.clearDisplay();
  display.drawBitmap(0, 9, logo_bmp, 128, 64, 1);
  display.setTextSize(1);
  display.setTextColor(WHITE);
  display.setCursor(10, 7);
  display.println("Be RAT, be silent.");
  display.display();
}

/*
 ********
 * MENU *
 ********
*/

void menuDisplay() {
  display.clearDisplay();
  // HUD
  hudDisplay(b_isConnectedToWifi, b_isConnectedToBT, b_isCharging, i_batteryPercent, c_currentTime);
  // MENU LIST
  int j = 0;
  for (int i = i_currentSelection; i < i_menuSize; i++) {
    if (i == i_currentSelection) {
      display.setTextColor(BLACK);
      display.fillRoundRect(0, 20 * (j + 1) - 3, 110, 18, 3, WHITE);
    } else {
      display.setTextColor(WHITE);
      display.drawRoundRect(0, 20 * (j + 1) - 3, 110, 18, 3, WHITE);
    }
    display.setTextSize(1);
    display.setCursor(4, 20 * (j + 1) + 2);
    display.printf("%d. %s", i + 1, c_menuItems[i]);
    if (c_menuItems[i] == "WIFI")      { display.drawBitmap(114, 20 * (j + 1), logo_wifi, 11, 11, WHITE); }
    if (c_menuItems[i] == "BLUETOOTH") { display.drawBitmap(114, 20 * (j + 1), logo_bt, 11, 11, WHITE); }
    if (c_menuItems[i] == "BADUSB")    { display.drawBitmap(114, 20 * (j + 1), logo_evilusb, 11, 11, WHITE); }
    if (c_menuItems[i] == "SETTINGS")  { display.drawBitmap(114, 20 * (j + 1), logo_settings, 11, 11, WHITE); }
    if (c_menuItems[i] == "TURN OFF")  { display.drawBitmap(114, 20 * (j + 1), logo_turnoff, 11, 11, WHITE); }
    if (c_menuItems[i] == "GAMES")     { display.drawBitmap(114, 20 * (j + 1), logo_games, 11, 11, WHITE);}
    j++;
  }
  display.display();
}

void hudDisplay(bool wifi, bool bt, bool charging, int percent, char current[]) {
  // STROKE
  display.drawLine(0, 15, 128, 15, WHITE);
  // WIFI
  if (wifi) {
    display.drawBitmap(0, 1, logo_wifi, 11, 11, 1);
  } else {
    display.drawBitmap(0, 1, logo_nowifi, 11, 11, 1);
  }
  // BLUETOOTH
  if (bt) {
    display.drawBitmap(15, 1, logo_bt, 11, 11, 1);
  } else {
    display.drawBitmap(15, 1, logo_nobt, 11, 11, 1);
  }
  // CHARGING
  if (charging) {
    display.setTextSize(1);
    display.setTextColor(WHITE);
    display.setCursor(98, 4);
    display.print("+");
  }
  // PERCENT OF BATTERY
  display.setTextSize(1);
  display.setTextColor(WHITE);
  display.setCursor(104, 4);
  display.printf("%d%%", percent);
  // CURRENT TIME
  display.setTextSize(1);
  display.setTextColor(WHITE);
  display.setCursor(50, 4);
  display.print(current);
}

void wifiDisplay() {
  display.clearDisplay();
  // HUD
  hudDisplay(b_isConnectedToWifi, b_isConnectedToBT, b_isCharging, i_batteryPercent, c_currentTime);
  // MENU LIST
  int j = 0;
  for (int i = i_currentSelection; i < i_wifiSize; i++) {
    if (i == i_currentSelection) {
      display.setTextColor(BLACK);
      display.fillRoundRect(0, 20 * (j + 1) - 3, 110, 18, 3, WHITE);
    } else {
      display.setTextColor(WHITE);
      display.drawRoundRect(0, 20 * (j + 1) - 3, 110, 18, 3, WHITE);
    }
    display.setTextSize(1);
    display.setCursor(4, 20 * (j + 1) + 2);
    display.printf("%d. %s", i + 1, c_wifiItems[i]);
    j++;
  }
  display.display();
}

void btDisplay() {
  display.clearDisplay();
  // HUD
  hudDisplay(b_isConnectedToWifi, b_isConnectedToBT, b_isCharging, i_batteryPercent, c_currentTime);
  // MENU LIST
  int j = 0;
  for (int i = i_currentSelection; i < i_btSize; i++) {
    if (i == i_currentSelection) {
      display.setTextColor(BLACK);
      display.fillRoundRect(0, 20 * (j + 1) - 3, 110, 18, 3, WHITE);
    } else {
      display.setTextColor(WHITE);
      display.drawRoundRect(0, 20 * (j + 1) - 3, 110, 18, 3, WHITE);
    }
    display.setTextSize(1);
    display.setCursor(4, 20 * (j + 1) + 2);
    display.printf("%d. %s", i + 1, c_btItems[i]);
    j++;
  }
  display.display();
}

void badusbDisplay() {
  display.clearDisplay();
  // HUD
  hudDisplay(b_isConnectedToWifi, b_isConnectedToBT, b_isCharging, i_batteryPercent, c_currentTime);
  // MENU LIST
  int j = 0;
  for (int i = i_currentSelection; i < i_badusbSize; i++) {
    if (i == i_currentSelection) {
      display.setTextColor(BLACK);
      display.fillRoundRect(0, 20 * (j + 1) - 3, 110, 18, 3, WHITE);
    } else {
      display.setTextColor(WHITE);
      display.drawRoundRect(0, 20 * (j + 1) - 3, 110, 18, 3, WHITE);
    }
    display.setTextSize(1);
    display.setCursor(4, 20 * (j + 1) + 2);
    display.printf("%d. %s", i + 1, c_badusbItems[i]);
    j++;
  }
  display.display();
}

void gamesDisplay() {
  display.clearDisplay();
  // HUD
  hudDisplay(b_isConnectedToWifi, b_isConnectedToBT, b_isCharging, i_batteryPercent, c_currentTime);
  // MENU LIST
  int j = 0;
  for (int i = i_currentSelection; i < i_gamesSize; i++) {
    if (i == i_currentSelection) {
      display.setTextColor(BLACK);
      display.fillRoundRect(0, 20 * (j + 1) - 3, 110, 18, 3, WHITE);
    } else {
      display.setTextColor(WHITE);
      display.drawRoundRect(0, 20 * (j + 1) - 3, 110, 18, 3, WHITE);
    }
    display.setTextSize(1);
    display.setCursor(4, 20 * (j + 1) + 2);
    display.printf("%d. %s", i + 1, c_gamesItems[i]);
    j++;
  }
  display.display();
}

void settingsDisplay() {
  display.clearDisplay();
  // HUD
  hudDisplay(b_isConnectedToWifi, b_isConnectedToBT, b_isCharging, i_batteryPercent, c_currentTime);
  // MENU LIST
  int j = 0;
  for (int i = i_currentSelection; i < i_settingsSize; i++) {
    if (i == i_currentSelection) {
      display.setTextColor(BLACK);
      display.fillRoundRect(0, 20 * (j + 1) - 3, 110, 18, 3, WHITE);
    } else {
      display.setTextColor(WHITE);
      display.drawRoundRect(0, 20 * (j + 1) - 3, 110, 18, 3, WHITE);
    }
    display.setTextSize(1);
    display.setCursor(4, 20 * (j + 1) + 2);
    display.printf("%d. %s", i + 1, c_settingsItems[i]);
    j++;
  }
  display.display();
}

void shutoff() {
  // Something
}
