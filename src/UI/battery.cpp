#include "UI/battery.h"

const unsigned char c_icon_bat_100 [] PROGMEM {
    0xF8, 0xFF, 0xFF, 0x7F, 0x04, 0x00, 0x00, 0x80, 0xF7, 0xFF, 0xFF, 0xBF, 
  0xF5, 0xFF, 0xFF, 0xBF, 0xF5, 0xFF, 0xFF, 0xBF, 0xF7, 0xFF, 0xFF, 0xBF, 
  0x04, 0x00, 0x00, 0x80, 0xF8, 0xFF, 0xFF, 0x7F,
};
const unsigned char c_icon_bat_75 [] PROGMEM {
    0xF8, 0xFF, 0xFF, 0x7F, 0x04, 0x00, 0x00, 0x80, 0x07, 0xFC, 0xFF, 0xBF, 
  0x05, 0xFC, 0xFF, 0xBF, 0x05, 0xFC, 0xFF, 0xBF, 0x07, 0xFC, 0xFF, 0xBF, 
  0x04, 0x00, 0x00, 0x80, 0xF8, 0xFF, 0xFF, 0x7F,
};
const unsigned char c_icon_bat_50 [] PROGMEM {
    0xF8, 0xFF, 0xFF, 0x7F, 0x04, 0x00, 0x00, 0x80, 0x07, 0x00, 0xFF, 0xBF, 
  0x05, 0x00, 0xFF, 0xBF, 0x05, 0x00, 0xFF, 0xBF, 0x07, 0x00, 0xFF, 0xBF, 
  0x04, 0x00, 0x00, 0x80, 0xF8, 0xFF, 0xFF, 0x7F,
};
const unsigned char c_icon_bat_25 [] PROGMEM {
    0xF8, 0xFF, 0xFF, 0x7F, 0x04, 0x00, 0x00, 0x80, 0x07, 0x00, 0xC0, 0xBF, 
  0x05, 0x00, 0xC0, 0xBF, 0x05, 0x00, 0xC0, 0xBF, 0x07, 0x00, 0xC0, 0xBF, 
  0x04, 0x00, 0x00, 0x80, 0xF8, 0xFF, 0xFF, 0x7F,
};
const unsigned char c_icon_bat_5 [] PROGMEM {
    0xF8, 0xFF, 0xFF, 0x7F, 0x04, 0x00, 0x00, 0x80, 0x07, 0x00, 0x00, 0x80, 
  0x05, 0x00, 0x00, 0x80, 0x05, 0x00, 0x00, 0x80, 0x07, 0x00, 0x00, 0x80, 
  0x04, 0x00, 0x00, 0x80, 0xF8, 0xFF, 0xFF, 0x7F,
};

U8G2_SSD1306_128X64_NONAME_F_HW_I2C display(U8G2_R0, U8X8_PIN_NONE);

Battery::Battery() {

}

void Battery::Start() {
    display.begin();
    i_percent = 100;
    b_isCharging = true;
    display.setBitmapMode(1);
}

void Battery::Display() {
    display.clearBuffer();

    display.setFont(u8g2_font_ncenB08_tr);
    display.setCursor(65, 12);
    display.print(i_percent);
    display.print("%");

    if (b_isCharging) {
      display.setCursor(58, 12);
      display.print("+");
    }

    if (i_percent <= 5) {
        display.drawXBMP(96, 4, 32, 8, c_icon_bat_5);
    } else if (i_percent <= 25) {
        display.drawXBMP(96, 4, 32, 8, c_icon_bat_25);
    } else if (i_percent <= 50) {
        display.drawXBMP(96, 4, 32, 8, c_icon_bat_50);
    } else if (i_percent <= 75) {
        display.drawXBMP(96, 4, 32, 8, c_icon_bat_75);
    } else {
        display.drawXBMP(96, 4, 32, 8, c_icon_bat_100);
    }

    display.sendBuffer();
}